## firmware/boards/lofree/lofree_edge/Kconfig.defconfig
```kconfig
if BOARD_LOFREE_EDGE
config ZMK_KEYBOARD_NAME
    default "Lofree Edge ZMK"
config ZMK_KSCAN_MATRIX_POLLING
    default y
config ZMK_KSCAN_GPIO_MATRIX
    default y
config TLSR_USB_OTA
    default y
config TLSR_BOOT_GUARD
    default y
config BOARD_EARLY_INIT_HOOK
    default y if TLSR_BOOT_GUARD_EARLY
config USB_HID_DEVICE_COUNT
    default 2 if TLSR_USB_OTA
config HID_INTERRUPT_EP_MPS
    default 64 if TLSR_USB_OTA
DT_CHOSEN_Z_SRAM := zephyr,sram
config SRAM_SIZE
    default $(dt_chosen_reg_size_int,$(DT_CHOSEN_Z_SRAM),0,K)
DT_CHOSEN_Z_FLASH := zephyr,flash
config FLASH_SIZE
    default $(dt_chosen_reg_size_int,$(DT_CHOSEN_Z_FLASH),0,K)
DT_CHOSEN_Z_CODE_PARTITION := zephyr,code-partition
config FLASH_LOAD_OFFSET
    default $(dt_chosen_reg_addr_hex,$(DT_CHOSEN_Z_CODE_PARTITION)) if USE_DT_CODE_PARTITION
config FLASH_LOAD_SIZE
    default $(dt_chosen_reg_size_hex,$(DT_CHOSEN_Z_CODE_PARTITION)) if USE_DT_CODE_PARTITION
endif
```

## firmware/boards/lofree/lofree_edge/Kconfig.lofree_edge
```kconfig
config BOARD_LOFREE_EDGE
    select SOC_TLSR8278

config LOFREE_EDGE_SWITCH_DIAGNOSTICS
    bool "Observe Edge candidate switch inputs (no automatic switching)"
    depends on BOARD_LOFREE_EDGE
    depends on !LOFREE_EDGE_MODE_SWITCH
    default n
    help
      Enable only PD5-PD7 inputs, with outputs disabled and pulls unchanged,
      as corroborated by stock initialization. Expose levels through the
      read-only board status report. No automatic transport policy is enabled.

config LOFREE_EDGE_MODE_SWITCH
    bool "Physical BT/ON/OFF switch controls Edge transports"
    depends on BOARD_LOFREE_EDGE && TLSR_BLE
    default n
    help
      Use the measured PD5/PD6 selector. ON enables USB only, BT enables
      Bluetooth only, and OFF enables neither. No transport fallback or
      output-key override is allowed. Moves use guarded planned restarts.

config LOFREE_EDGE_STUDIO_IO_DIAGNOSTICS
    bool "Read-only Studio receive/dispatch/transmit counters"
    depends on BOARD_LOFREE_EDGE && ZMK_STUDIO && UART_INTERRUPT_DRIVEN
    default n
    help
      Diagnostic builds only. Expose bounded protocol counters via HID feature9.
      No payloads, key values, arbitrary memory access or persistent writes.
```

## firmware/boards/lofree/lofree_edge/board.yml
```yaml
board:
  name: lofree_edge
  full_name: Lofree Edge Experimental USB
  vendor: lofree
  socs:
    - name: tlsr8278
```

## firmware/boards/lofree/lofree_edge/lofree_edge_defconfig
```kconfig
CONFIG_LLVM_USE_LLD=y
CONFIG_TC32_BOOT_MIRROR_SIZE=0x2800
CONFIG_GPIO=y
CONFIG_ZMK_USB=y
CONFIG_ZMK_BLE=n
CONFIG_USB_DC_TELINK_B87_IRQ_LINES=n
CONFIG_TLSR_USB_POLL_TIMER=y
CONFIG_SOC_TLSR8278_EARLY_WATCHDOG_MS=4000
CONFIG_TC32_FAST_DIV64=n
CONFIG_TC32_POP_PC_RETURNS=n
CONFIG_FLASH=y
CONFIG_TIMEOUT_64BIT=y
CONFIG_ZMK_EXT_POWER=n
CONFIG_ZMK_KSCAN_EVENT_QUEUE_SIZE=32
CONFIG_ZMK_HID_INDICATORS=y
CONFIG_LED=y
CONFIG_ZMK_BACKLIGHT=y
CONFIG_ZMK_BACKLIGHT_BRT_START=50
CONFIG_ZMK_BACKLIGHT_BRT_STEP=10
CONFIG_ZMK_BACKLIGHT_ON_START=y
CONFIG_ZMK_BACKLIGHT_AUTO_OFF_IDLE=y
CONFIG_USB_DEVICE_REMOTE_WAKEUP=y
CONFIG_USB_SELF_POWERED=n
CONFIG_USB_MAX_POWER=50
CONFIG_TLSR_BOOT_GUARD_CHORD=y
CONFIG_TLSR_BOOT_GUARD_CHORD_ROW=5
CONFIG_TLSR_BOOT_GUARD_CHORD_COL_A=10
CONFIG_TLSR_BOOT_GUARD_CHORD_ROW_B=4
CONFIG_TLSR_BOOT_GUARD_CHORD_COL_B=14
CONFIG_TLSR_BOOT_GUARD_CHORD_AFTER_COUNT=y
```

## firmware/dts/bindings/kscan/lofree,edge-kscan-matrix.yaml
```yaml
description: Edge matrix with a shared Caps Lock indicator column
compatible: "lofree,edge-kscan-matrix"
include: "zmk,kscan-gpio-matrix.yaml"
properties:
  caps-source-gpios:
    type: phandle-array
    required: true
    description: Stock PC1 high source for the shared-column Caps indicator
  indicator-power-gpios:
    type: phandle-array
    required: true
    description: Stock PD3 output-high enable
  indicator-enable-gpios:
    type: phandle-array
    required: true
    description: PA7 output-high in physically observed running stock firmware
```

## firmware/dts/bindings/led/lofree,edge-backlight.yaml
```yaml
description: Lofree Edge white backlight on PB4 PWM4
compatible: "lofree,edge-backlight"
child-binding:
  description: The single white key backlight
  properties:
    label:
      type: string
```

## firmware/dts/bindings/misc/lofree,edge-mode-switch.yaml
```yaml
# SPDX-License-Identifier: GPL-3.0-or-later
description: |
  Edge BT/ON/OFF selector, measured with the input-only diagnostic. PD5 low
  selects Bluetooth; otherwise PD6 low selects OFF; both high select USB ON.
  The controller preserves pulls and output latches and never drives contacts.
compatible: "lofree,edge-mode-switch"
properties:
  bt-gpios:
    type: phandle-array
    required: true
  off-gpios:
    type: phandle-array
    required: true
```
